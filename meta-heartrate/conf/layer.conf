## meta-heartrate/conf/layer.conf
```bitbake
# We have a conf and classes directory, add to BBPATH
BBPATH .= ":${LAYERDIR}"

# We have recipes-* directories, add to BBFILES
BBFILES += "${LAYERDIR}/recipes-*/*/*.bb \
            ${LAYERDIR}/recipes-*/*/*.bbappend"

BBFILE_COLLECTIONS += "meta-heartrate"
BBFILE_PATTERN_meta-heartrate = "^${LAYERDIR}/"
BBFILE_PRIORITY_meta-heartrate = "6"

LAYERDEPENDS_meta-heartrate = "core"
LAYERSERIES_COMPAT_meta-heartrate = "kirkstone"
```
